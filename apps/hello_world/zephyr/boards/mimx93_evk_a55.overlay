/*
 * Copyright 2024 NXP
 *
 * SPDX-License-Identifier: BSD-3-Clause
 */

#include "mcimx93evk_ca55/rtos_memory.h"

/delete-node/ &sram0;

/ {
	sram0: memory@SRAM_BASE {
		reg = <DT_ADDR(SRAM_BASE) DT_SIZE_M(1)>;
	};
};
