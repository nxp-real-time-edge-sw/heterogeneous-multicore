## apps/hello_world/freertos/boards/imx952evk/Kconfig
```kconfig
# Copyright 2025-2026 NXP
#
# SPDX-License-Identifier: BSD-3-Clause

rsource "Kconfig.defconfig"
orsource "${core_id}/Kconfig"

config MCUX_HW_BOARD_imx952evk
    bool
    default y
    imply MCUX_HW_DEVICE_MIMX9529
```

## apps/hello_world/freertos/boards/imx952evk/ca55/Kconfig
```kconfig
# Copyright 2026 NXP
#
# SPDX-License-Identifier: BSD-3-Clause

config MCUX_HW_BOARD_imx952evk_ca55
    bool
    default y
    select MCUX_COMPONENT_component.sm.imx952_ca55
```

## apps/hello_world/freertos/boards/imx952evk/cm7/Kconfig
```kconfig
# Copyright 2026 NXP
#
# SPDX-License-Identifier: BSD-3-Clause

config MCUX_HW_BOARD_imx952evk_cm7
    bool
    default y
    imply MCUX_COMPONENT_middleware.freertos-kernel.cm7f if MCUX_COMPONENT_middleware.freertos-kernel
```

## west.yml
```yaml
manifest:
  remotes:
  - name: nxp
    url-base: https://github.com/NXP
  - name: nxp_zephyr
    url-base: https://github.com/nxp-zephyr
  - name: nxp-mcuxpresso
    url-base: https://github.com/nxp-mcuxpresso
  - name: nxp-realtimeedge
    url-base: https://github.com/nxp-real-time-edge-sw
  defaults:
    remote: nxp-mcuxpresso

  group-filter:
  - -bifrost

  self:
    path: heterogeneous-multicore

  projects:
    - name: mcuxsdk-manifests
      revision: 8e1f9c6f972bff4b8a472a1b63e21e88284d83db
      import:
        path-prefix: mcuxsdk
        # remove name-allowlist in order to download full SDK
        name-allowlist:
          - core
          - CMSIS
          - mcu-sdk-examples
          - mcu-sdk-components
          - mcu-sdk-doc
          - mcux-devices-imx
          - mcux-devices-rt
          - mcux-devices-mcx
          - mcux-devices-kinetis
          - mcux-devices-lpc
          - mcux-sdk-middleware-multicore
          - freertos-kernel
          - rpmsg-lite
          - lwip
          - soem
          # include lvgl in order to remove kconfig definition warnings.
          - lvgl

    - name: zephyr
      remote: nxp_zephyr
      revision: 5cc0697a9246384a89ad69b04fbfde475f539821
      import:
        path-prefix: zsdk
        name-allowlist:
          - cmsis
          - cmsis_6
          - libmetal
          - open-amp

    #
    # NXP based overrides of Zephyr modules and additional
    # added modules
    #
    - name: hal_nxp
      remote: nxp_zephyr
      revision: 87363e2e5869444017d58a54a5f86fa561f89f4d
      path: zsdk/modules/hal/nxp


    # For internal NXP development support
    - name: bifrost
      remote: nxp-realtimeedge
      west-commands: scripts/west_commands.yml
      repo-path: bifrost
      revision: feature/heterogeneous_multicore
      groups:
        - bifrost
```
