## apps/hello_world/freertos/boards/imx943evk/Kconfig
```kconfig
# Copyright 2025 NXP
#
# SPDX-License-Identifier: BSD-3-Clause

rsource "Kconfig.defconfig"

config MCUX_HW_BOARD_imx943evk
    bool
    default y
    imply MCUX_HW_DEVICE_MIMX94398
    imply MCUX_COMPONENT_driver.mu1
    imply MCUX_COMPONENT_component.sm.crc
    imply MCUX_COMPONENT_component.sm.scmi
    imply MCUX_COMPONENT_component.sm.smt
```

## apps/rpmsg_str_echo/zephyr/boards/imx8mp_evk_mimx8ml8_a53.conf
```kconfig
# Copyright 2025-2026 NXP
#
# SPDX-License-Identifier: BSD-3-Clause

CONFIG_MAX_XLAT_TABLES=20

CONFIG_MBOX_GEN_SW=y

CONFIG_CACHE_MANAGEMENT=y

CONFIG_OPENAMP_WITH_DCACHE=y
```

## apps/rt_latency/zephyr/boards/imx8mp_evk_mimx8ml8_a53.conf
```kconfig
# Enable Zephyr's GPT Counter driver
CONFIG_COUNTER_MCUX_GPT=y

CONFIG_KERNEL_BIN_NAME="rt_latency_ca53"
```

## apps/rt_latency/zephyr/boards/mimx8mp_evk_a53.conf
```kconfig
# Map GPT memory regions and include mcux sdk driver
CONFIG_HAS_MCUX_GPT=y
# Enable Zephyr's GPT Counter driver
CONFIG_COUNTER_MCUX_GPT=y

CONFIG_KERNEL_BIN_NAME="rt_latency_ca53"
```

## apps/soem_digital_io/zephyr/boards/imx8mp_evk_mimx8ml8_a53.conf
```kconfig
# Enable Zephyr's GPT Counter driver
CONFIG_COUNTER_MCUX_GPT=y

CONFIG_KERNEL_BIN_NAME="soem_digital_io_ca53"
```

## apps/soem_digital_io/zephyr/boards/imx95_evk_mimx9596_a55.conf
```kconfig
CONFIG_COUNTER_MCUX_TPM=y

CONFIG_HEAP_MEM_POOL_SIZE=851968

CONFIG_KERNEL_BIN_NAME="soem_digital_io_ca55"
```

## net/boards/evkmimxrt1180/cm33/mcux/Kconfig
```kconfig
config MCUX_PRJSEG_module.hmc.virtual_sw_lib
    bool "DSA library"
    default y if MCUX_PRJSEG_config.board.dsa_switch || MCUX_PRJSEG_config.board.dsa_enetc
```
