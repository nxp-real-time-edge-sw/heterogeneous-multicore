/*
 * Copyright 2025 NXP
 *
 * SPDX-License-Identifier: BSD-3-Clause
 */

/ {
	chosen {
		zephyr,console = &lpuart2;
		zephyr,shell-uart = &lpuart2;
	};
};

&lpuart1 {
	status = "disabled";
};

&lpuart2 {
	status = "okay";
};
